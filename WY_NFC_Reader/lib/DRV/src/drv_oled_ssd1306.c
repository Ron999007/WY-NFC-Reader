/**
 * @file    drv_oled_ssd1306.c
 * @brief   SSD1306/SSD1315 OLED Driver Implementation.
 */

#include "drv_oled_ssd1306.h"
#include <string.h>

static void send_cmd(ssd1306_obj_t *obj, uint8_t cmd) {
    if (obj && obj->io) {
        obj->io->write_reg(obj->io->user_data, obj->i2c_addr, 0x00, &cmd, 1);
    }
}

static const uint8_t font_5x8[][5] = {
    {0x00,0x00,0x00,0x00,0x00},{0x00,0x00,0x2f,0x00,0x00},{0x00,0x07,0x00,0x07,0x00}, /* Space, !, " */
    {0x14,0x7f,0x14,0x7f,0x14},{0x24,0x2a,0x7f,0x2a,0x12},{0x23,0x13,0x08,0x64,0x62}, /* #, $, % */
    {0x36,0x49,0x55,0x22,0x50},{0x00,0x05,0x03,0x00,0x00},{0x00,0x1c,0x22,0x41,0x00}, /* &, ', ( */
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    {0x00,0x41,0x36,0x08,0x00},{0x08,0x04,0x08,0x10,0x08}                              /* }, ~ */
};

void drv_oled_ssd1306_init(ssd1306_obj_t *obj, i2c_io_interface_t *io, uint8_t i2c_addr, oled_resolution_e res) {
    if (!obj || !io) return;
    
    obj->io = io;
    obj->i2c_addr = i2c_addr;
    
    /* Dynamically configure dimensions based on resolution */
    if (res == OLED_RES_128X64) {
        obj->width = 128;
        obj->height = 64;
        obj->pages = 8;
    } else {
        obj->width = 128;
        obj->height = 32;
        obj->pages = 4;
    }
    
    obj->io->delay_ms(100); /* Power stabilization */

    send_cmd(obj, 0xAE); /* Display OFF */
    send_cmd(obj, 0xD5); send_cmd(obj, 0x80); /* Clock Divide Ratio */
    
    /* Multiplex Ratio dynamically set to Height - 1 */
    send_cmd(obj, 0xA8); send_cmd(obj, obj->height - 1); 
    
    send_cmd(obj, 0xD3); send_cmd(obj, 0x00); /* Display Offset */
    send_cmd(obj, 0x40); /* Display Start Line 0 */
    send_cmd(obj, 0x8D); send_cmd(obj, 0x14); /* Charge Pump */
    send_cmd(obj, 0x20); send_cmd(obj, 0x00); /* Horizontal Addressing */
    send_cmd(obj, 0xA1); /* Segment Re-map */
    send_cmd(obj, 0xC8); /* COM Output Scan Direction */
    
    /* COM Pins Hardware Configuration differs between 32 and 64 height */
    send_cmd(obj, 0xDA); send_cmd(obj, (obj->height == 64) ? 0x12 : 0x02); 
    
    send_cmd(obj, 0x81); send_cmd(obj, 0x8F); /* Contrast */
    send_cmd(obj, 0xD9); send_cmd(obj, 0xF1); /* Pre-charge */
    send_cmd(obj, 0xDB); send_cmd(obj, 0x40); /* VCOMH Deselect */
    send_cmd(obj, 0xA4); /* Entire Display ON resume */
    send_cmd(obj, 0xA6); /* Normal Display */
    send_cmd(obj, 0xAF); /* Display ON */

    drv_oled_ssd1306_clear(obj);
}

void drv_oled_ssd1306_clear(ssd1306_obj_t *obj) {
    if (obj) memset(obj->buffer, 0x00, sizeof(obj->buffer));
}

void drv_oled_ssd1306_draw_pixel(ssd1306_obj_t *obj, int16_t x, int16_t y, bool color) {
    if (!obj || x < 0 || x >= obj->width || y < 0 || y >= obj->height) return;
    if (color) obj->buffer[x + (y / 8) * obj->width] |=  (1 << (y % 8));
    else       obj->buffer[x + (y / 8) * obj->width] &= ~(1 << (y % 8));
}

void drv_oled_ssd1306_draw_bitmap(ssd1306_obj_t *obj, int16_t x, int16_t y, const uint8_t *bitmap, uint8_t w, uint8_t h) {
    if (!obj || !bitmap) return;
    uint16_t byte_idx = 0;
    for (uint8_t page = 0; page < (h + 7) / 8; page++) {
        for (uint8_t col = 0; col < w; col++) {
            uint8_t data = bitmap[byte_idx++];
            for (uint8_t bit = 0; bit < 8; bit++) {
                if (y + page * 8 + bit < y + h) {
                    drv_oled_ssd1306_draw_pixel(obj, x + col, y + page * 8 + bit, (data & (1 << bit)) != 0);
                }
            }
        }
    }
}

void drv_oled_ssd1306_draw_char(ssd1306_obj_t *obj, int16_t x, int16_t y, char c, oled_scale_e scale) {
    if (c < 32 || c > 126) return;
    uint8_t font_idx = c - 32; 

    if (scale == OLED_SCALE_1X) {
        for (uint8_t dx = 0; dx < 5; dx++) {
            uint8_t line = font_5x8[font_idx][dx];
            for (uint8_t dy = 0; dy < 8; dy++) {
                if (line & (1 << dy)) drv_oled_ssd1306_draw_pixel(obj, x + dx, y + dy, true);
            }
        }
    } 
    else if (scale == OLED_SCALE_1_5X) {
        const uint8_t map15_x[7]  = {0, 1, 1, 2, 3, 3, 4}; 
        const uint8_t map15_y[12] = {0, 1, 1, 2, 3, 3, 4, 5, 5, 6, 7, 7}; 
        for (uint8_t dx = 0; dx < 7; dx++) {
            uint8_t line = font_5x8[font_idx][map15_x[dx]];
            for (uint8_t dy = 0; dy < 12; dy++) {
                if (line & (1 << map15_y[dy])) drv_oled_ssd1306_draw_pixel(obj, x + dx, y + dy, true);
            }
        }
    }
    else if (scale == OLED_SCALE_2X) {
        for (uint8_t dx = 0; dx < 10; dx++) {
            uint8_t line = font_5x8[font_idx][dx / 2];
            for (uint8_t dy = 0; dy < 16; dy++) {
                if (line & (1 << (dy / 2))) drv_oled_ssd1306_draw_pixel(obj, x + dx, y + dy, true);
            }
        }
    }
}

void drv_oled_ssd1306_print(ssd1306_obj_t *obj, int16_t x, int16_t y, const char *str, oled_scale_e scale) {
    uint8_t char_width = 0;
    if (scale == OLED_SCALE_1X)        { char_width = 6;  } 
    else if (scale == OLED_SCALE_1_5X) { char_width = 8;  } 
    else if (scale == OLED_SCALE_2X)   { char_width = 12; } 
    else return;

    while (*str) {
        drv_oled_ssd1306_draw_char(obj, x, y, *str++, scale);
        x += char_width; 
    }
}

void drv_oled_ssd1306_update_page(ssd1306_obj_t *obj, uint8_t page) {
    if (!obj || !obj->io || page >= obj->pages) return;
    send_cmd(obj, 0x21); send_cmd(obj, 0x00); send_cmd(obj, 0x7F); 
    send_cmd(obj, 0x22); send_cmd(obj, page); send_cmd(obj, page); 
    obj->io->write_reg(obj->io->user_data, obj->i2c_addr, 0x40, &obj->buffer[page * obj->width], obj->width);
}